## boards/stm32h747i_disco_stm32h747xx_m7.conf
```kconfig
# 增加堆疊空間以利後續影像處理
CONFIG_HEAP_MEM_POOL_SIZE=16384
CONFIG_MAIN_STACK_SIZE=16384

# 為了保險起見，把 ISR (中斷) 堆疊也稍微加大
CONFIG_ISR_STACK_SIZE=8192

# 這是之前的設定，保持不變
CONFIG_LOG_BUFFER_SIZE=4096
```
